#include "global.h"

// driver for the BMI270 IMU https://www.bosch-sensortec.com/media/boschsensortec/downloads/datasheets/bst-bmi270-ds000.pdf
// and ICM-42688-P https://invensense.tdk.com/wp-content/uploads/2020/04/ds-000347_icm-42688-p-datasheet.pdf

// gyro calibration procedure
static volatile bool calibrateGyro = false;
static u32 gyroCalibratedCycles = 0; // counts up the cycles for the gyro calibration, calibration is done if the value is 2000
static i32 gyroCalibrationOffsetTemp[3] = {0}; // temporary offset that gets added to the gyro values during calibration
// accel calibration procedure
static volatile bool calibrateAccel = false;
volatile u8 accelCalState = 0;
volatile bool accelCalDone = false;
static u16 accelCalibratedCycles = 0; // counts up the cycles for the accel calibration, calibration is done if the value is 2000
static i32 accelCalibrationOffsetTemp[3] = {0};
// imu alignment procedure
static volatile bool alignImu = false;
volatile u8 imuAlignmentStep = 0;
volatile bool imuAlignmentDone = false;
volatile i16 imuAlignmentCounter = 0;
static u8 firstAxis = 0;

static u8 imuAlignment[3] = {0, 2, 4}; // +-X, +-Y, +-Z

// calibration offset
static i32 gyroCalibrationOffset[3]; // offset that gets subtracted from the gyro values
static i32 accelCalibrationOffset[3]; // offset that gets subtracted from the accelerometer values

// IMU raw data and their copies
static volatile i16 agDataRaw[6] __attribute__((aligned(4))) = {0}; // raw register reads
static i32 gyroDataRaw[3]; // after applying offset, but no scaling/filtering etc.
static i32 accelDataRaw[3]; // after applying offset, but no scaling/filtering etc.
static mutex_t agDataRawAccess;

// Data
i32 gyroAligned[3];
fix32 gyroScaled[3];
static PT1 gyroDataFilter[3];
const fix32 *const gyroFiltered[3] = {&gyroDataFilter[0].getConstRef(), &gyroDataFilter[1].getConstRef(), &gyroDataFilter[2].getConstRef()};
i32 accelAligned[3];
fix32 accelScaled[3];
static PT1 accelDataFilter[3];
const fix32 *const accelFiltered[3] = {&accelDataFilter[0].getConstRef(), &accelDataFilter[1].getConstRef(), &accelDataFilter[2].getConstRef()};

static volatile u8 gyroDmaTxChannel = 0, gyroDmaRxChannel = 0;
u32 gyroUpdateFlag = 0;
static volatile u8 gyroInterrupts = 0;
static elapsedMicros taskTimerGyro = 0;

// regWrite/regRead aliases to allow identical use regardless of HW SPI / PIO SPI
#ifdef GYRO_HALFDUPLEX_SPI
static volatile u8 spiSm = 0;
#define REG_WR(reg, buf, ...) regWrite(PIO_GYRO_SPI, spiSm, PIN_GYRO_CS, ((u8)reg), buf, __VA_ARGS__);
#define REG_RD(reg, buf, ...) regRead(PIO_GYRO_SPI, spiSm, PIN_GYRO_CS, ((u8)reg), buf, __VA_ARGS__);
#else
#define REG_WR(reg, buf, ...) regWrite(SPI_GYRO, PIN_GYRO_CS, ((u8)reg), buf, __VA_ARGS__);
#define REG_RD(reg, buf, ...) regRead(SPI_GYRO, PIN_GYRO_CS, ((u8)reg), buf, __VA_ARGS__);
#endif

// IMU data fetching: DMA stuff
#ifdef GYRO_BMI270
extern const u8 bmi270_config_file[8192];
#define GYRO_SPI_SPEED 10000000
static volatile const u32 gyroDmaTxData[14] = {(0x100UL | 0x80UL | (u32)GyroReg::ACC_X_LSB) << 23, 0x00, 0x00, 0x00, 0x00, 0x00, 0x00, 0x00, 0x00, 0x00, 0x00, 0x00, 0x00, 0x00};
#elifdef GYRO_ICM42688P
#define GYRO_SPI_SPEED 24000000
static volatile const u32 gyroDmaTxData[13] = {0x80UL | (u32)GyroReg::ACC_X_MSB, 0x00, 0x00, 0x00, 0x00, 0x00, 0x00, 0x00, 0x00, 0x00, 0x00, 0x00, 0x00};
#endif
#define GYRO_DMA_LENGTH ARRAYLEN(gyroDmaTxData)
static volatile u32 gyroDmaRxData[GYRO_DMA_LENGTH] = {0};
static elapsedMicros gyroInterruptTimer = 0;
static void fetchGyro();

void gyroLoop() {
	if (gyroInterruptTimer > 1000000 / PID_FREQ * 2) {
		tasks[TASK_GYROREAD].debugInfo = 2;
		gyroInterruptTimer = 0;
		fetchGyro();
	}
	if (gyroInterrupts) {
		u32 duration = taskTimerGyro;
		if (tasks[TASK_GYROREAD].maxGap < duration)
			tasks[TASK_GYROREAD].maxGap = duration;
		TASK_START(TASK_GYROREAD);

		i16 agCopy[6];
		if (mutex_try_enter(&agDataRawAccess, nullptr)) {
			memcpy(agCopy, (void *)agDataRaw, 12);
			mutex_exit(&agDataRawAccess);
		} else {
			tasks[TASK_GYROREAD].errorCount++;
			TASK_END(TASK_GYROREAD);
			return;
		}

		gyroInterrupts--;
		if (gyroInterrupts > 3) {
			gyroInterrupts = 3;
		}

		i32 gyroLut[6];
		i32 accelLut[6];
		for (int i = 0; i < 3; i += 1) {
			int dbl = i << 1;
			accelDataRaw[i] = agCopy[i] - accelCalibrationOffset[i];
			gyroLut[dbl] = gyroDataRaw[i];
			gyroLut[dbl + 1] = -gyroLut[dbl];
			gyroDataRaw[i] = agCopy[3 + i] - gyroCalibrationOffset[i];
			accelLut[dbl] = accelDataRaw[i];
			accelLut[dbl + 1] = -accelLut[dbl];
		}
		for (int i = 0; i < 3; i++) {
			// gyro data in range of -.5 ... +.5 due to fixed point math, convert to range of -2000 ... +2000 (dps)
			gyroAligned[i] = gyroLut[imuAlignment[i]];
			gyroScaled[i].setRaw(gyroAligned[i] * 4000);
			gyroDataFilter[i].update(gyroScaled[i]);
			// accel data in range of -.5 ... +.5 due to fixed point math, convert to range of -16g ... +16g (9.81 * 16 * 2)
			accelAligned[i] = accelLut[imuAlignment[i]];
			accelScaled[i].setRaw(accelAligned[i] * 314);
			accelDataFilter[i].update(accelScaled[i]);
		}
		gyroUpdateFlag = 0xFFFFFFFF;

		if (armingDisableFlags & 0x40) {
			bool isStill = true;
			bool isVeryStill = true;
			for (int ax = 0; ax < 3; ax++) {
				if (abs(gyroDataRaw[ax]) >= GYRO_CALIBRATION_TOLERANCE) isVeryStill = false;
				// if (abs(gyroDataRaw[ax]) >= 5 * GYRO_CALIBRATION_TOLERANCE) isStill = false;
			}

			if (calibrateGyro) {
				if (isVeryStill) {
					// ignore -1 (0xFFFF), as this speaks for a communication error
					gyroCalibratedCycles++;
					if (gyroCalibratedCycles >= QUIET_SAMPLES) {
						gyroCalibrationOffsetTemp[0] += gyroDataRaw[0];
						gyroCalibrationOffsetTemp[1] += gyroDataRaw[1];
						gyroCalibrationOffsetTemp[2] += gyroDataRaw[2];
					}
					if (gyroCalibratedCycles == CALIBRATION_SAMPLES + QUIET_SAMPLES) {
						if (!alignImu && !calibrateAccel)
							armingDisableFlags &= ~0x40;
						// add CALIBRATION_SAMPLES / 2 to get proper rounding
						// Since C++ doesn't always floor, it actually truncates, we need to add CALIBRATION_SAMPLES / 2 and subtract CALIBRATION_SAMPLES for negative values
						gyroCalibrationOffset[0] = (gyroCalibrationOffsetTemp[0] + (gyroCalibrationOffset[0] > 0 ? CALIBRATION_SAMPLES : -CALIBRATION_SAMPLES) / 2) / CALIBRATION_SAMPLES;
						gyroCalibrationOffset[1] = (gyroCalibrationOffsetTemp[1] + (gyroCalibrationOffset[1] > 0 ? CALIBRATION_SAMPLES : -CALIBRATION_SAMPLES) / 2) / CALIBRATION_SAMPLES;
						gyroCalibrationOffset[2] = (gyroCalibrationOffsetTemp[2] + (gyroCalibrationOffset[2] > 0 ? CALIBRATION_SAMPLES : -CALIBRATION_SAMPLES) / 2) / CALIBRATION_SAMPLES;
						gyroCalibrationOffset[0] = constrain(gyroCalibrationOffset[0], -20, 20);
						gyroCalibrationOffset[1] = constrain(gyroCalibrationOffset[1], -20, 20);
						gyroCalibrationOffset[2] = constrain(gyroCalibrationOffset[2], -20, 20);
						calibrateGyro = false;
					}
				} else {
					gyroCalibrationOffsetTemp[0] = 0;
					gyroCalibrationOffsetTemp[1] = 0;
					gyroCalibrationOffsetTemp[2] = 0;
					gyroCalibratedCycles = 0;
				}
			}
			if (calibrateAccel) {
				if (isVeryStill) {
					accelCalibratedCycles++;
					if (accelCalibratedCycles >= CALIBRATION_SAMPLES) {
						// TODO respect alignment
						accelCalibrationOffsetTemp[0] += accelDataRaw[0];
						accelCalibrationOffsetTemp[1] += accelDataRaw[1];
						accelCalibrationOffsetTemp[2] += accelDataRaw[2] - 2048;
						accelCalState = 2;
					}
					if (accelCalibratedCycles == CALIBRATION_SAMPLES + QUIET_SAMPLES) {
						if (!alignImu && !calibrateGyro)
							armingDisableFlags &= ~0x40;
						accelCalibrationOffset[0] = (accelCalibrationOffsetTemp[0] + (accelCalibrationOffset[0] > 0 ? CALIBRATION_SAMPLES : -CALIBRATION_SAMPLES) / 2) / CALIBRATION_SAMPLES;
						accelCalibrationOffset[1] = (accelCalibrationOffsetTemp[1] + (accelCalibrationOffset[1] > 0 ? CALIBRATION_SAMPLES : -CALIBRATION_SAMPLES) / 2) / CALIBRATION_SAMPLES;
						accelCalibrationOffset[2] = (accelCalibrationOffsetTemp[2] + (accelCalibrationOffset[2] > 0 ? CALIBRATION_SAMPLES : -CALIBRATION_SAMPLES) / 2) / CALIBRATION_SAMPLES;
						accelCalDone = true;
						accelCalState = 0;
						calibrateAccel = false;
					}
				} else {
					accelCalibrationOffsetTemp[0] = 0;
					accelCalibrationOffsetTemp[1] = 0;
					accelCalibrationOffsetTemp[2] = 0;
					accelCalibratedCycles = 0;
				}
			}
			static elapsedMicros x = 0;
			bool y = false;
			if (x > 200000) {
				x = 0;
				y = true;
			}
			if (alignImu) {
				static u32 newAxisCounter = 0;
				static u8 lastAxis = 0;
				static u8 thisAxis = 255;
				u8 newAxis = 255;
				for (int i = 0; i < 3; i++) {
					for (int j = 0; j < 2; j++) {
						int x = abs(accelDataRaw[i] * (j ? -1 : 1) - 2048);
						int y = abs(accelDataRaw[(i + 1) % 3]);
						int z = abs(accelDataRaw[(i + 2) % 3]);
						if (x < IMU_ALIGNMENT_TOLERANCE &&
							y < IMU_ALIGNMENT_TOLERANCE &&
							z < IMU_ALIGNMENT_TOLERANCE) {
							newAxis = i * 2 + j;
							break;
						}
					}
					if (newAxis != 255) break;
				}
				if (newAxis != thisAxis) {
					// filter out some noise
					if (++newAxisCounter == 10) {
						thisAxis = newAxis;
						newAxisCounter = 0;
					}
				} else {
					newAxisCounter = 0;
				}
				switch (imuAlignmentStep) {
				case 1:
					if (!isStill) thisAxis = 255;

					if (thisAxis != lastAxis || thisAxis == 255) {
						lastAxis = thisAxis;
						if (imuAlignmentCounter > 0) imuAlignmentCounter = 0;
						break;
					}
					if (++imuAlignmentCounter >= PID_FREQ * 1) {
						firstAxis = thisAxis;
						imuAlignmentCounter = 0;
						imuAlignmentStep = 2;
					}
					break;
				case 2:
					if (!isStill || (thisAxis & ~1) == (firstAxis & ~1)) thisAxis = 255;

					if (thisAxis != lastAxis || thisAxis == 255) {
						lastAxis = thisAxis;
						imuAlignmentCounter = 0;
						break;
					}
					if (++imuAlignmentCounter >= PID_FREQ * 1) {
						// found orientation, calculate third one
						firstAxis ^= 1; // we found up axis, but we want down axis
						thisAxis ^= 1; // we found back axis, but we want forward axis
						u8 a0 = thisAxis / 2;
						u8 a1 = 0;
						u8 a2 = firstAxis / 2;

						// find missing axis (forward/backward irrelevant)
						for (; a1 < 3; a1++) {
							if (a1 != a0 && a1 != a2) break;
						}

						// check for sanity
						if (a1 == 3 || a0 == a2) {
							// should not happen
							imuAlignmentStep = 0;
							alignImu = false;
							if (!calibrateGyro && !calibrateAccel)
								armingDisableFlags &= ~0x40;
							break;
						}

						// possibly invert (to make right-handed)
						a1 *= 2;
						if (a2 - a0 == 1 || a0 - a2 == 2) a1 += 1;

						// possibly invert again if a1 OR a0 is inverted
						a1 ^= (thisAxis ^ firstAxis) & 1;

						imuAlignment[AXIS_ROLL] = thisAxis;
						imuAlignment[AXIS_PITCH] = a1;
						imuAlignment[AXIS_YAW] = firstAxis;

						imuAlignmentCounter = 0;
						imuAlignmentStep = 0;
						imuAlignmentDone = true;
						if (!calibrateGyro && !calibrateAccel)
							armingDisableFlags &= ~0x40;
					}
					break;
				}
			}
		}
		TASK_END(TASK_GYROREAD);
		taskTimerGyro = 0;
	}
}

static void gyroGpioInterrupt(uint _gpio, uint32_t _events) {
	tasks[TASK_GYROREAD].debugInfo = 1;
	gyroInterruptTimer = 0;
	fetchGyro();
}
static void fetchGyro() {
	// abort channels if they are not done
	dma_channel_abort(gyroDmaRxChannel);
	dma_channel_abort(gyroDmaTxChannel);
	while (dma_channel_is_busy(gyroDmaRxChannel) || dma_channel_is_busy(gyroDmaTxChannel) || dma_hw->abort & (1u << gyroDmaRxChannel) || dma_hw->abort & (1u << gyroDmaTxChannel)) {
		// wait until busy is deasserted and abort is cleared (12.6.8.3 and E5)
		tight_loop_contents();
	}

	// prepare chip select
	gpio_put(PIN_GYRO_CS, 0);

	// clear RX(/TX) FIFO if needed
#ifdef GYRO_HALFDUPLEX_SPI
	pio_sm_clear_fifos(PIO_GYRO_SPI, spiSm);
#else
	while (spi_is_readable(SPI_GYRO))
		(void)SPI_GYRO_HW->dr;
#endif

	// prepare channels and start them in sync
	dma_channel_set_transfer_count(gyroDmaRxChannel, GYRO_DMA_LENGTH, false);
	dma_channel_set_write_addr(gyroDmaRxChannel, gyroDmaRxData, false);
	dma_channel_set_transfer_count(gyroDmaTxChannel, GYRO_DMA_LENGTH, false);
	dma_channel_set_read_addr(gyroDmaTxChannel, gyroDmaTxData, false);
	dma_start_channel_mask((1u << gyroDmaRxChannel) | (1u << gyroDmaTxChannel));
}

void gyroDmaInterrupt() {
	u32 interrupts = dma_hw->intr;
	if (interrupts & (1u << gyroDmaRxChannel)) {
		gpio_put(PIN_GYRO_CS, 1);
		dma_hw->ints1 = 1u << gyroDmaRxChannel;
		if (!mutex_try_enter(&agDataRawAccess, nullptr)) {
			tasks[TASK_GYROREAD].errorCount++;
			return;
		}
		u8 *data = (u8 *)agDataRaw;
#ifdef GYRO_BMI270
		for (int i = 0; i < GYRO_DMA_LENGTH - 2; i++) {
			data[i] = (u8)(gyroDmaRxData[i + 2] & 0xFF);
		}
#elifdef GYRO_ICM42688P
		for (int i = 0; i < GYRO_DMA_LENGTH - 1; i++) {
			data[i] = (u8)(gyroDmaRxData[i + 1] & 0xFF);
		}
#endif
		mutex_exit(&agDataRawAccess);
		gyroInterrupts++;
	}
}

int gyroInit() {
	addPointerSetting(SETTING_ACC_CAL, accelCalibrationOffset, 3);
	addPointerSetting(SETTING_IMU_ALIGNMENT, imuAlignment, 3);

	addSetting(SETTING_GYRO_FILTER_CUTOFF, &gyroFilterCutoff, 100);
	addSetting(SETTING_ACC_FILTER_CUTOFF, &accelFilterCutoff, 100);

	mutex_init(&agDataRawAccess);

	gyroDataFilter[0] = PT1(gyroFilterCutoff, PID_FREQ);
	gyroDataFilter[1] = PT1(gyroFilterCutoff, PID_FREQ);
	gyroDataFilter[2] = PT1(gyroFilterCutoff, PID_FREQ);
	accelDataFilter[0] = PT1(accelFilterCutoff, PID_FREQ);
	accelDataFilter[1] = PT1(accelFilterCutoff, PID_FREQ);
	accelDataFilter[2] = PT1(accelFilterCutoff, PID_FREQ);

	armingDisableFlags |= 0x40;
	calibrateGyro = true;

	// set up pins
	gpio_init(PIN_GYRO_INT1);
	gpio_set_dir(PIN_GYRO_INT1, GPIO_IN);
	gpio_init(PIN_GYRO_CS);
	gpio_set_dir(PIN_GYRO_CS, GPIO_OUT);
	gpio_put(PIN_GYRO_CS, 1);
	gpio_init(PIN_GYRO_SCLK);
	gpio_set_dir(PIN_GYRO_SCLK, GPIO_OUT);
#ifdef GYRO_HALFDUPLEX_SPI
	gpio_init(PIN_GYRO_SDX);
	gpio_set_dir(PIN_GYRO_SDX, GPIO_IN);

	// set up pio (half duplex SPI)
	u8 offset = pio_add_program(PIO_GYRO_SPI, &halfduplex_spi_11_program);
	spiSm = pio_claim_unused_sm(PIO_GYRO_SPI, true);
	pio_sm_config c = halfduplex_spi_11_program_get_default_config(offset);
	pio_gpio_init(PIO_GYRO_SPI, PIN_GYRO_SCLK);
	pio_gpio_init(PIO_GYRO_SPI, PIN_GYRO_SDX);
	sm_config_set_in_pins(&c, PIN_GYRO_SDX);
	sm_config_set_sideset(&c, 2, true, false);
	sm_config_set_sideset_pins(&c, PIN_GYRO_SCLK);
	sm_config_set_out_pins(&c, PIN_GYRO_SDX, 1);
	pio_sm_set_consecutive_pindirs(PIO_GYRO_SPI, spiSm, PIN_GYRO_SCLK, 1, true);
	sm_config_set_out_shift(&c, false, false, 9);
	sm_config_set_in_shift(&c, false, false, 8);
	pio_sm_init(PIO_GYRO_SPI, spiSm, offset, &c);
	pio_sm_set_enabled(PIO_GYRO_SPI, spiSm, true);
	pio_sm_put(PIO_GYRO_SPI, spiSm, 0); // dummy write to set clock polarity (mode 11)
	pio_sm_set_clkdiv_int_frac8(PIO_GYRO_SPI, spiSm, 3, 128); // set clock divider to 3.5 => (264 / 3.5 / 8 (ticks per bit)) = 9.4MHz (max 10MHz)
#else
	gpio_init(PIN_GYRO_MISO);
	gpio_set_dir(PIN_GYRO_MISO, GPIO_IN);
	gpio_init(PIN_GYRO_MOSI);
	gpio_set_dir(PIN_GYRO_MOSI, GPIO_OUT);

	spi_init(SPI_GYRO, GYRO_SPI_SPEED);
	spi_set_format(SPI_GYRO, 8, SPI_CPOL_0, SPI_CPHA_0, SPI_MSB_FIRST);
	gpio_set_function(PIN_GYRO_SCLK, GPIO_FUNC_SPI);
	gpio_set_function(PIN_GYRO_MISO, GPIO_FUNC_SPI);
	gpio_set_function(PIN_GYRO_MOSI, GPIO_FUNC_SPI);
#endif

#ifdef GYRO_BMI270
	u8 data = 0xB6;
	REG_WR(GyroReg::CMD, &data, 1, 500); // soft reset
	for (int i = 0; i < 50 && data != 0x24; i++) {
		sleep_ms(2);
		data = 1;
		REG_WR(GyroReg::IF_CONF, &data, 1, 500); // set SPI mode to 3 wire
		REG_RD(GyroReg::IF_CONF, &data, 1, true); // read IF_CONF
		data = 0;
		REG_RD(GyroReg::CHIP_ID, &data, 1, true); // read chip id
	}
	if (data != 0x24) {
		Serial.print("Failed to load BMI270, wrong Chip ID: "); // chip id should be 0x24
		Serial.println(data, HEX);
		return 1;
	}
	data = 0;
	REG_WR(GyroReg::PWR_CONF, &data, 1, 500); // disable PWR_CONF.adv_power_save
	data = 0;
	REG_WR(GyroReg::INIT_CTRL, &data, 1, 500); // prepare config load
	REG_WR(GyroReg::INIT_DATA, bmi270_config_file, sizeof(bmi270_config_file), 500); // load config
	data = 1;
	REG_WR(GyroReg::INIT_CTRL, &data, 1, 500); // complete config load

	// check initialization status
	data = 0;
	for (int i = 0; i < 50 && (data & 0x6F) != 0x01; i++) {
		sleep_ms(1); // should always be below 20ms, but we wait a bit longer to be sure
		REG_RD(GyroReg::INTERNAL_STATUS, &data, 1, true);
	}
	if ((data & 0x6F) != 0x01) {
		sleep_ms(5000);
		Serial.print("Failed to load BMI270, wrong initialization status: "); // initialization status should be 0x01
		Serial.println(data, HEX);
		return 2;
	}

	// enable performance mode (p. 22)
	// PWR_CTRL: temp_en (3) | acc_en (2) | gyr_en (1) | aux_en (0)
	data = 0b1110; // temp, accel and gyro enabled
	REG_WR(GyroReg::PWR_CTRL, &data, 1, 500);
	// ACC_CONF: acc_filter_perf (7) | acc_bwp (6...4) | acc_odr (3...0)
	data = 1 << 7 | 0x02 << 4 | 0x0C; // performance optimized, no averaging, 1600Hz
	REG_WR(GyroReg::ACC_CONF, &data, 1, 500);
	// ACC_RANGE: acc_range (1...0)
	data = 0x03; // +/- 16g
	REG_WR(GyroReg::ACC_RANGE, &data, 1, 500);
	// GYR_CONF: gyr_filter_perf (7) | gyr_noise_perf (6) | gyr_bwp (5...4) | gyr_odr (3...0)
	data = 1 << 7 | 1 << 6 | 0x00 << 4 | 0x0D; // performance optimized, 3200Hz
	REG_WR(GyroReg::GYR_CONF, &data, 1, 500);
	// GYR_RANGE: ois_range (3) | gyr_range (2...0)
	data = 0x00; // +/- 2000dps
	REG_WR(GyroReg::GYR_RANGE, &data, 1, 500);
	data = 0x02;
	REG_WR(GyroReg::PWR_CONF, &data, 1, 500);

	// INT_MAP_DATA: err_int2, drdy_int2, fwm_int2, ffull_int2, err_int1, drdy_int1, fwm_int1, ffull_int1
	data = 0b10000100;
	REG_WR(GyroReg::INT_MAP_DATA, &data, 1, 500);
	// INT1_IO_CTRL: input_en (4), output_en (3), output_driver (2), output_lvl (1)
	data = 0b1010;
	REG_WR(GyroReg::INT1_IO_CTRL, &data, 1, 500);
	// INT2_IO_CTRL: input_en (4), output_en (3), output_driver (2), output_lvl (1)
	data = 0b1010;
	REG_WR(GyroReg::INT2_IO_CTRL, &data, 1, 500);
	// INT_LATCH: int_latch(0)
	data = 0x00;
	REG_WR(GyroReg::INT_LATCH, &data, 1, 500);
#elifdef GYRO_ICM42688P
	// create 32 kHz clock output for gyro
	gpio_init(PIN_GYRO_CLKIN);
	gpio_set_dir(PIN_GYRO_CLKIN, GPIO_OUT);
	gpio_set_function(PIN_GYRO_CLKIN, GPIO_FUNC_PWM);
	u8 sliceNum = pwm_gpio_to_slice_num(PIN_GYRO_CLKIN);
	u32 cpu = clock_get_hz(clk_sys); // 360k
	u32 totalDiv = cpu / 32000; // 11250
	u8 pwmDivInt = totalDiv / 50;
	pwm_set_clkdiv_int_frac4(sliceNum, pwmDivInt, 0);
	pwm_set_wrap(sliceNum, 49); // 32 kHz
	pwm_set_enabled(sliceNum, true);
	pwm_set_gpio_level(PIN_GYRO_CLKIN, 25);

	u8 data = 0x01;
	REG_WR(GyroReg::DEVICE_CONFIG, &data, 1);
	for (int i = 0; i < 50 && data != 0x47; i++) {
		sleep_ms(2);
		data = 0;
		REG_RD(GyroReg::WHO_AM_I, &data, 1); // read chip id
	}
	if (data != 0x47) {
		Serial.print("Failed to load ICM-42688-P, wrong Chip ID: ");
		Serial.println(data, HEX);
		return 1;
	}
	// interrupt config: int1 pulsed, push-pull, active high
	data = 0b000011;
	REG_WR(GyroReg::INT_CONFIG, &data, 1);
	// switch sensor data to little endian
	data = 0x20;
	REG_WR(GyroReg::INTF_CONFIG0, &data, 1);
	// enable RTC
	data = 0x95;
	REG_WR(GyroReg::INTF_CONFIG1, &data, 1);
	// gyro 2000deg/s, 4000Hz
	data = 0x00 | (PID_FREQ == 8000 ? 0x3 : 0x4);
	REG_WR(GyroReg::GYRO_CONFIG0, &data, 1);
	// accel 16g, 4000Hz
	data = 0x00 | (PID_FREQ == 8000 ? 0x3 : 0x4);
	REG_WR(GyroReg::ACCEL_CONFIG0, &data, 1);
	// temp sensor: 5Hz DLPF, gyro 2nd order UI, 3rd order DEC2_M2
	data = 0xD6;
	REG_WR(GyroReg::GYRO_CONFIG1, &data, 1)
	// interrupt config that is required for 8khz operation
	data = 0b01100000;
	REG_WR(GyroReg::INT_CONFIG1, &data, 1);
	// route drdy to int1
	data = 0x08;
	REG_WR(GyroReg::INT_SOURCE0, &data, 1);

	// switch to page 1
	data = 1;
	REG_WR(GyroReg::REG_BANK_SEL, &data, 1);
	// set gyro AAF to 348Hz
	u8 buf[3];
	buf[0] = 8; // DELT
	buf[1] = 64 & 0xFF; // DELTSQR
	buf[2] = ((64 >> 8) & 0xF) | (9 << 4);
	REG_WR(GyroReg::GYRO_CONFIG_STATIC3, buf, 3);
	// int2 as CLKIN
	data = 0b10 << 1;
	REG_WR(GyroReg::INTF_CONFIG5, &data, 1);

	// switch to page 2
	data = 2;
	REG_WR(GyroReg::REG_BANK_SEL, &data, 1);
	// set accel AAF to 348Hz
	buf[0] = 8 << 1; // DELT
	buf[1] = 64 & 0xFF; // DELTSQR
	buf[2] = ((64 >> 8) & 0xF) | (9 << 4);
	REG_WR(GyroReg::ACCEL_CONFIG_STATIC2, buf, 3);

	// switch to page 0
	data = 0;
	REG_WR(GyroReg::REG_BANK_SEL, &data, 1);
	// enable gyro/accel in low noise mode, keep temp sensor enabled, needs to be the last step, do not write any other registers for 200us afterwards
	data = 0b00001111;
	REG_WR(GyroReg::PWR_MGMT0, &data, 1, 200);

#endif

	// set up DMA channel
	gyroDmaTxChannel = dma_claim_unused_channel(true);
	gyroDmaRxChannel = dma_claim_unused_channel(true);
	dma_channel_config gyroDmaTxConfig = dma_channel_get_default_config(gyroDmaTxChannel);
	dma_channel_config gyroDmaRxConfig = dma_channel_get_default_config(gyroDmaRxChannel);
	channel_config_set_read_increment(&gyroDmaTxConfig, true);
	channel_config_set_write_increment(&gyroDmaTxConfig, false);
	channel_config_set_read_increment(&gyroDmaRxConfig, false);
	channel_config_set_write_increment(&gyroDmaRxConfig, true);
#ifdef GYRO_HALFDUPLEX_SPI
	channel_config_set_dreq(&gyroDmaTxConfig, pio_get_dreq(PIO_GYRO_SPI, spiSm, true));
	channel_config_set_dreq(&gyroDmaRxConfig, pio_get_dreq(PIO_GYRO_SPI, spiSm, false));
#else
	channel_config_set_dreq(&gyroDmaTxConfig, spi_get_dreq(SPI_GYRO, true));
	channel_config_set_dreq(&gyroDmaRxConfig, spi_get_dreq(SPI_GYRO, false));
#endif
	channel_config_set_transfer_data_size(&gyroDmaTxConfig, DMA_SIZE_32);
	channel_config_set_transfer_data_size(&gyroDmaRxConfig, DMA_SIZE_32);
	dma_channel_set_config(gyroDmaTxChannel, &gyroDmaTxConfig, false);
	dma_channel_set_config(gyroDmaRxChannel, &gyroDmaRxConfig, false);
	dma_channel_set_irq1_enabled(gyroDmaRxChannel, true); // enable interrupt once transfer is done
#ifdef GYRO_HALFDUPLEX_SPI
	dma_channel_set_write_addr(gyroDmaTxChannel, &PIO_GYRO_SPI->txf[spiSm], false);
	dma_channel_set_read_addr(gyroDmaRxChannel, &PIO_GYRO_SPI->rxf[spiSm], false);
#else
	// SPI TX and RX FIFO are the same register
	dma_channel_set_write_addr(gyroDmaTxChannel, &SPI_GYRO_HW->dr, false);
	dma_channel_set_read_addr(gyroDmaRxChannel, &SPI_GYRO_HW->dr, false);
#endif
	irq_set_exclusive_handler(DMA_IRQ_1, &gyroDmaInterrupt);
	irq_set_enabled(DMA_IRQ_1, true);

	gpio_set_irq_enabled_with_callback(PIN_GYRO_INT1, GPIO_IRQ_EDGE_RISE, true, &gyroGpioInterrupt);

	return 0;
}

void startGyroCalibration() {
	gyroCalibrationOffsetTemp[0] = 0;
	gyroCalibrationOffsetTemp[1] = 0;
	gyroCalibrationOffsetTemp[2] = 0;
	gyroCalibratedCycles = 0;
	gyroCalibrationOffset[0] = 0;
	gyroCalibrationOffset[1] = 0;
	gyroCalibrationOffset[2] = 0;
	armingDisableFlags |= 0x40;
	calibrateGyro = true;
}

void getGyroCalibration(i16 cal[3]) {
	cal[0] = gyroCalibrationOffset[0];
	cal[1] = gyroCalibrationOffset[1];
	cal[2] = gyroCalibrationOffset[2];
}

void startAccelCalibration() {
	accelCalibratedCycles = 0;
	accelCalibrationOffset[0] = 0;
	accelCalibrationOffset[1] = 0;
	accelCalibrationOffset[2] = 0;
	accelCalState = 1;
	accelCalibrationOffsetTemp[0] = 0;
	accelCalibrationOffsetTemp[1] = 0;
	accelCalibrationOffsetTemp[2] = 0;
	armingDisableFlags |= 0x40;
	calibrateAccel = true;
}

void startImuAlignment() {
	imuAlignmentStep = 1;
	imuAlignmentCounter = -PID_FREQ * 1;
	armingDisableFlags |= 0x40;
	alignImu = true;
}
void getImuAlignment(u8 axes[3]) {
	memcpy(axes, imuAlignment, 3);
}

#ifdef GYRO_BMI270
// config file needs to be uploaded to the BMI270 before it can be used
constexpr u8 bmi270_config_file[8192] PROGMEM = {
	0xc8, 0x2e, 0x00, 0x2e, 0x80, 0x2e, 0x3d, 0xb1, 0xc8, 0x2e, 0x00, 0x2e, 0x80, 0x2e, 0x91, 0x03, 0x80, 0x2e, 0xbc,
	0xb0, 0x80, 0x2e, 0xa3, 0x03, 0xc8, 0x2e, 0x00, 0x2e, 0x80, 0x2e, 0x00, 0xb0, 0x50, 0x30, 0x21, 0x2e, 0x59, 0xf5,
	0x10, 0x30, 0x21, 0x2e, 0x6a, 0xf5, 0x80, 0x2e, 0x3b, 0x03, 0x00, 0x00, 0x00, 0x00, 0x08, 0x19, 0x01, 0x00, 0x22,
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	0x2e, 0x00, 0xc1};
#endif // config file
